int q = 0;
uint16_t pulse_time = 2;
uint16_t pulse_delay = 1000;

void setup() {
  pinMode(A0, INPUT); // потенциометр на A0 (задаёт длительность импульса)
  pinMode(A1, INPUT); // потенциометр на A1 (задаёт паузу между импульсами)
  pinMode(7, INPUT);  // вход кнопки вкл/выкл регулировки частоты и длительности импульса → пин D7
  pinMode(4, INPUT);  // вход сигнала от компаратора датчика тока → пин D4
  pinMode(3, OUTPUT); // выход сигнала для управления мосфетом → пин D3
  pinMode(6, OUTPUT); // выход на оптопару STOP → пин D6
  pinMode(5, OUTPUT); // выход на оптопару RESUME → пин D5
}

void loop() {
  bool current_sensor = false;

  if (PIND & (1 << 7)) {  // если кнопка на пине D7 включена (подано 5В на пин D7), выключаем генерацию импульсов и запускаем опрос потенциометров
    digitalWrite(3, 0);   // закрываем мосфет
    digitalWrite(5, 0);   // выключаем оптопару RESUME
    digitalWrite(6, 1);   // включаем оптопару PAUSE (ставим станок на паузу)

    pulse_time = analogRead(A0);  // Чтение потенциометра на A0 (задаёт длительность импульса)
    pulse_delay = analogRead(A1); // Чтение потенциометра на A1 (задаёт паузу между импульсами)

    pulse_time = map(pulse_time, 0, 1024, 2, 25);  // ограничиваем длительность импульса в диапазон от 2 до 25 мкс
    pulse_time = constrain(pulse_time, 2, 25);  

    pulse_delay = map(pulse_delay, 0, 1024, 40, 1000);  // ограничиваем длительность паузы между импульсами в диапазон от 40 до 1000 мкс (задаёт частоту: 1-20 кГц)
    pulse_delay = constrain(pulse_delay, 40, 1000); 
  }

  else {           // если кнопка на пине D7 выключена (подано GND на пин D7), запускаем генерацию импульсов
    PORTD |= (1 << PD3);                 // подаём на пин D3 высокий сигнал (открываем транзистор)
    delayMicroseconds(pulse_time);       // выдерживаем длительность импульса
    current_sensor = (PIND & (1 << 4));  // читаем на пине D4 есть ли ток    
    PORTD &= ~(1 << PD3);                // подаём на пин D3 низкий сигнал (закрываем транзистор)
    delayMicroseconds(pulse_delay);      // пауза между импульсами

    if (current_sensor) { // если в момент импульса был ток, то добавляем к переменной "q" единицу
      q = q + 1;
      if (q > 1000) q = 1000;
    }
    else q = q - 1; // если в момент импульса не было тока, то отнимаем 1
    if (q < 0) q = 0;

    if (q <= 850) { // если полезных импульсов мало, жмём RESUME  (включаем оптопару на пине D5)
      digitalWrite(6, 0);
      digitalWrite(5, 1);
    }
    if (q >= 950) { // если полезных импульсов слишком много, жмём PAUSE (включаем оптопару на пине D6)
      digitalWrite(5, 0);
      digitalWrite(6, 1);
    }
  }
}
